## boards/shields/nice_view_disp/Kconfig.defconfig
```kconfig
# Copyright (c) 2023 The ZMK Contributors
# SPDX-License-Identifier: MIT

if SHIELD_NICE_VIEW_DISP

config CUSTOM_ANIMATION_SPEED
    int "Total duration in milliseconds for animation to take"
    default 300000

config LV_Z_VDB_SIZE
    default 100

config LV_DPI_DEF
    default 161

config LV_Z_BITS_PER_PIXEL
    default 1

choice LV_COLOR_DEPTH
    default LV_COLOR_DEPTH_1
endchoice

choice ZMK_DISPLAY_WORK_QUEUE
    default ZMK_DISPLAY_WORK_QUEUE_DEDICATED
endchoice

choice ZMK_DISPLAY_STATUS_SCREEN
    default ZMK_DISPLAY_STATUS_SCREEN_CUSTOM
endchoice

config LV_Z_MEM_POOL_SIZE
    default 4096 if ZMK_DISPLAY_STATUS_SCREEN_CUSTOM

config ZMK_DISPLAY_STATUS_SCREEN_CUSTOM
    imply NICE_VIEW_DISP_WIDGET_STATUS

config NICE_VIEW_DISP_WIDGET_STATUS
    bool "Custom nice!view status widget"
    select LV_FONT_MONTSERRAT_16
    select LV_USE_IMG
    select LV_USE_CANVAS
    select LV_USE_ANIMIMG 
    select LV_USE_ANIMATION

config NICE_VIEW_DISP_WIDGET_INVERTED
    bool "Invert custom status widget colors"

if !ZMK_SPLIT || ZMK_SPLIT_ROLE_CENTRAL

config NICE_VIEW_DISP_WIDGET_STATUS
    select LV_FONT_MONTSERRAT_18
    select LV_FONT_MONTSERRAT_14
    select LV_FONT_UNSCII_8
    select ZMK_WPM

endif # !ZMK_SPLIT || ZMK_SPLIT_ROLE_CENTRAL

config ZMK_DISPLAY_STATUS_SCREEN_BUILT_IN
    select LV_FONT_MONTSERRAT_26

endif # SHIELD_NICE_VIEW_DISP

if SHIELD_SOFLE_CHOC_PRO_DONGLE

# Max 16 characters in keyboard name
config ZMK_KEYBOARD_NAME
    default "Sofle Choc Pro BT"

config ZMK_SPLIT_ROLE_CENTRAL
    default y

config ZMK_SPLIT
    default y

# Set this to the number of peripherals your dongle will have.
# For a unibody, this would be 1. If you have left and right halves, set it to 2, etc.
config ZMK_SPLIT_BLE_CENTRAL_PERIPHERALS
    default 2

# Set this to ZMK_SPLIT_BLE_CENTRAL_PERIPHERALS + your desired number of BT profiles (default is 5)
config BT_MAX_CONN
    default 5

# Set this to the same number as BT_MAX_CONN
config BT_MAX_PAIRED
    default 5

endif
```

## boards/shields/nice_view_disp/Kconfig.shield
```kconfig
# Copyright (c) 2022 The ZMK Contributors
# SPDX-License-Identifier: MIT

config SHIELD_NICE_VIEW_DISP
    def_bool $(shields_list_contains,nice_view_disp)

config SHIELD_SOFLE_PRO_DONGLE
    def_bool $(shields_list_contains,sofle_pro_dongle)
```

## boards/shields/sofle_choc_pro_dongle/Kconfig.defconfig
```kconfig
if SHIELD_SOFLE_CHOC_PRO_DONGLE

# Max 16 characters
config ZMK_KEYBOARD_NAME
    default "Sofle Dongle"

config ZMK_SPLIT_ROLE_CENTRAL
    default y

config ZMK_SPLIT
    default y

# Two peripherals: the left and right halves.
config ZMK_SPLIT_BLE_CENTRAL_PERIPHERALS
    default 2

# ZMK_SPLIT_BLE_CENTRAL_PERIPHERALS (2) + desired BT output profiles (5).
config BT_MAX_CONN
    default 5

# Same number as BT_MAX_CONN.
config BT_MAX_PAIRED
    default 5

endif
```

## config/west.yml
```yaml
manifest:
  remotes:
    - name: zmkfirmware
      url-base: https://github.com/zmkfirmware
    - name: prospector
      url-base: https://github.com/t-ogura
    # Additional modules containing boards/shields/custom code can be listed here as well
    # See https://docs.zephyrproject.org/3.2.0/develop/west/manifest.html#projects
  projects:
    - name: zmk
      remote: zmkfirmware
      revision: v0.3
      import: app/west.yml
    - name: prospector-zmk-module
      remote: prospector
      revision: v2.0.0
      path: modules/prospector-zmk-module
  self:
    path: config
```
